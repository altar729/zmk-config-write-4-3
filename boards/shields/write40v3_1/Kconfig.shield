## boards/shields/write40v3_1/Kconfig.shield
```kconfig
# No whitespace after the comma or in your keyboard name!
config SHIELD_WRITE40V3_1
    def_bool $(shields_list_contains,write40v3_1)
```

## boards/shields/zmk_write40v3_1/Kconfig.defconfig
```kconfig
if SHIELD_ZMK_WRITE40V3_1

config ZMK_KEYBOARD_NAME
    default "Write40v3_1"

endif # SHIELD_ZMK_WRITE40V3_1
```

## boards/shields/zmk_write40v3_1/Kconfig.shield
```kconfig
config SHIELD_ZMK_WRITE40V3_1
    def_bool $(shields_list_contains,zmk_write40v3_1)
```

## config/shields/write40v3_1/Kconfig.defconfig
```kconfig
if SHIELD_WRITE40V3_1

# Name must be less than 16 characters long!
config ZMK_KEYBOARD_NAME
    default "Write40 v3.1"

endif
```
